## layers/meta-gbear/conf/layer.conf
```bitbake
BBPATH =. "${LAYERDIR}:"
BBFILES += "${LAYERDIR}/recipes-*/*/*.bb ${LAYERDIR}/recipes-*/*/*.bbappend"

BBFILE_COLLECTIONS += "gbear"
BBFILE_PATTERN_gbear = "^${LAYERDIR}/"
BBFILE_PRIORITY_gbear = "50"

LAYERVERSION_gbear = "4"
LAYERSERIES_COMPAT_gbear = "honister"

# This is used by the tegra-distro-sanity bbclass
# to identify the distro layer directory during
# bblayers checks.
TD_DISTRO_LAYERDIR = "${LAYERDIR}"
```

## layers/meta-gbeos/conf/distro/include/gbeos-base.inc
```bitbake
require conf/distro/poky.conf

DISTRO = "gbeos-base"
DISTRO_NAME = "GreatBear Distro Base"
DISTRO_VERSION = "3.4-snapshot-${DATE}"

DISTRO_FEATURES_append = "wifi virtualization systemd python seccomp k3s"

IMAGE_INSTALL_append = "linux-firmware kernel-modules wpa-supplicant bash parted e2fsprogs e2fsprogs-resize2fs k3s dpkg glibc-utils python3 python3-pip curl "
IMAGE_INSTALL_append = "python3-ansible python3-ansible-core python3-cffi python3-cryptography python3-jinja2 python3-markupsafe python3-packaging python3-pycparser python3-pyparsing python3-pyyaml python3-resolvelib"

DISTRO_FEATURES_BACKFILL_CONSIDERED += "sysvinit"
VIRTUAL-RUNTIME_init_manager = "systemd"
VIRTUAL-RUNTIME_initscripts = "systemd-compat-units"
```

## layers/meta-gbeos/conf/distro/tegra-gbeos-dev.conf
```bitbake
require conf/distro/include/gbeos-base.inc

DISTRO = "gbeos dev"
DISTRO_VERSION = "0.1"
DISTRO_NAME = "gbeos-dev"
DISTRO_CODENAME = "mud"
```

## layers/meta-greatbear/conf/distro/gbeos.conf
```bitbake
DISTRO = "gbeos"
DISTRO_NAME = "GreatBear Edge OS Distro"
DISTRO_VERSION = "1.0-rc0"
DISTRO_CODENAME = "alcor"

MAINTAINER = "Fabien Andrieux <fandrieu@cisco.com>"

GB_DEFAULT_DISTRO_FEATURES = "ptest systemd pam virtualization security k3s x11 opengl"

DISTRO_FEATURES ?= "${DISTRO_FEATURES_DEFAULT} ${GB_DEFAULT_DISTRO_FEATURES}"

PACKAGE_CLASSES ?= "package_deb"

INIT_MANAGER = "systemd"

DISTRO_FEATURES:append = " systemd seccomp bash"
DISTRO_FEATURES_BACKFILL_CONSIDERED:append = " sysvinit"
VIRTUAL-RUNTIME_init_manager = "systemd"
VIRTUAL-RUNTIME_initscripts = "systemd-compat-units"
VIRTUAL-RUNTIME_login_manager = "shadow-base"
VIRTUAL-RUNTIME_dev_manager = "systemd"


require conf/distro/include/yocto-uninative.inc
require conf/distro/include/init-manager-systemd.inc

INHERIT += "uninative"
```

## layers/meta-greatbear/conf/layer.conf
```bitbake
# We have a conf and classes directory, add to BBPATH
BBPATH .= ":${LAYERDIR}"

# We have recipes-* directories, add to BBFILES
BBFILES += "${LAYERDIR}/recipes-*/*/*.bb \
            ${LAYERDIR}/recipes-*/*/*.bbappend"

BBFILE_COLLECTIONS += "meta-greatbear"
BBFILE_PATTERN_meta-greatbear = "^${LAYERDIR}/"
BBFILE_PRIORITY_meta-greatbear = "6"

LAYERDEPENDS_meta-greatbear = "core"
LAYERSERIES_COMPAT_meta-greatbear = "hardknott honister langdale kirkstone"
```
