## layers/meta-tegrademo/conf/distro/tegrademo-minsize.conf
```bitbake
include tegrademo.conf

require conf/distro/include/minsize.inc

DISTRO = "tegrademo-minsize"
DISTRO_NAME = "OE4Tegra Demonstration Distro (Min Size)"
```
